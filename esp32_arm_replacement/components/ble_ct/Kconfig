## esp32c3_idf/sdkconfig.defaults
```kconfig
# ESP32-C3 target is set in CMakeLists.txt via set(IDF_TARGET "esp32c3")
CONFIG_ESPTOOLPY_FLASHSIZE_4MB=y
# mbedTLS 裁剪
CONFIG_MBEDTLS_CERTIFICATE_BUNDLE=y
# CONFIG_MBEDTLS_CERTIFICATE_BUNDLE_DEFAULT_FULL is not set
CONFIG_MBEDTLS_SSL_IN_CONTENT_LEN=4096
CONFIG_MBEDTLS_SSL_OUT_CONTENT_LEN=2048
# CONFIG_MBEDTLS_SSL_KEEP_PEER_CERTIFICATE is not set
# CONFIG_MBEDTLS_PKCS7_C is not set

CONFIG_PARTITION_TABLE_CUSTOM=y
CONFIG_PARTITION_TABLE_CUSTOM_FILENAME="partitions.csv"
CONFIG_BOOTLOADER_APP_ROLLBACK_ENABLE=y

CONFIG_CS_INV_UART_TX_PIN=0
CONFIG_CS_INV_UART_RX_PIN=1

# WiFi 内存优化 (为 BLE 腾出 RAM)
CONFIG_ESP_WIFI_STATIC_RX_BUFFER_NUM=4
CONFIG_ESP_WIFI_DYNAMIC_RX_BUFFER_NUM=8
CONFIG_ESP_WIFI_DYNAMIC_TX_BUFFER_NUM=6
CONFIG_ESP_WIFI_RX_BA_WIN=4
CONFIG_ESP_WIFI_SOFTAP_SUPPORT=y

# BLE NimBLE 内存优化 (仅做 PERIPHERAL 配网)
CONFIG_BT_ENABLED=y
CONFIG_BT_NIMBLE_ENABLED=y
CONFIG_BT_NIMBLE_ROLE_PERIPHERAL=y
# CONFIG_BT_NIMBLE_ROLE_CENTRAL is not set
CONFIG_BT_NIMBLE_ROLE_BROADCASTER=y
# CONFIG_BT_NIMBLE_ROLE_OBSERVER is not set
CONFIG_BT_NIMBLE_MAX_CONNECTIONS=1
CONFIG_BT_NIMBLE_MAX_BONDS=1
CONFIG_BT_NIMBLE_MAX_CCCDS=4
CONFIG_BT_NIMBLE_MSYS_1_BLOCK_COUNT=8
CONFIG_BT_NIMBLE_MSYS_2_BLOCK_COUNT=4
CONFIG_BT_NIMBLE_HOST_TASK_STACK_SIZE=4096
CONFIG_BT_NIMBLE_ATT_PREFERRED_MTU=256
CONFIG_BT_NIMBLE_ATT_MAX_PREP_ENTRIES=4
CONFIG_BT_NIMBLE_GATT_MAX_PROCS=1
CONFIG_BT_NIMBLE_TRANSPORT_ACL_FROM_LL_COUNT=8
CONFIG_BT_NIMBLE_TRANSPORT_EVT_COUNT=8
CONFIG_BT_NIMBLE_TRANSPORT_EVT_DISCARD_COUNT=2
CONFIG_BT_NIMBLE_LOW_SPEED_MODE=y
# CONFIG_BT_NIMBLE_PROX_SERVICE is not set
# CONFIG_BT_NIMBLE_ANS_SERVICE is not set
# CONFIG_BT_NIMBLE_CTS_SERVICE is not set
# CONFIG_BT_NIMBLE_HTP_SERVICE is not set
# CONFIG_BT_NIMBLE_IPSS_SERVICE is not set
# CONFIG_BT_NIMBLE_TPS_SERVICE is not set
# CONFIG_BT_NIMBLE_IAS_SERVICE is not set
# CONFIG_BT_NIMBLE_LLS_SERVICE is not set
# CONFIG_BT_NIMBLE_SPS_SERVICE is not set
# CONFIG_BT_NIMBLE_HR_SERVICE is not set
# CONFIG_BT_NIMBLE_BAS_SERVICE is not set
# CONFIG_BT_NIMBLE_DIS_SERVICE is not set
# CONFIG_BT_NIMBLE_DTM_MODE_TEST is not set

CONFIG_XTAL_FREQ_40=y

CONFIG_MQTT_PROTOCOL_311=y
CONFIG_MQTT_BUFFER_SIZE=2048
CONFIG_MQTT_TASK_STACK_SIZE=6144

# HTTPS 仍需要（MQTT TLS）
CONFIG_ESP_HTTP_CLIENT_ENABLE_HTTPS=y

CONFIG_FREERTOS_HZ=1000
CONFIG_ESP_TASK_WDT_TIMEOUT_S=30
CONFIG_ESP_MAIN_TASK_STACK_SIZE=6144
CONFIG_ESP_SYSTEM_EVENT_TASK_STACK_SIZE=4096

CONFIG_COMPILER_OPTIMIZATION_SIZE=y

CONFIG_CS_INV_LED1_PIN=12
CONFIG_CS_INV_LED2_PIN=13
```

## esp32c3_l10_idf/main/Kconfig.projbuild
```kconfig
menu "CS_INV L10 Module"

    config CS_INV_ADMIN_PASSWORD
        string "USB serial administrator password (empty disables SN changes)"
        default ""
        help
            Independent password for set_sn <password> <SN> on USB Serial/JTAG.
            SN writes require matching ARM App CS 0x09 support and verified readback.

    config CS_INV_UART_TX_PIN
        int "UART TX GPIO (U0TXD)"
        default 1

    config CS_INV_UART_RX_PIN
        int "UART RX GPIO (U0RXD)"
        default 0

    config CS_INV_UART_BAUD
        int "UART baudrate"
        default 115200

    config CS_INV_WIFI_SSID
        string "WiFi SSID (NVS 无配置时使用, 留空则等待)"
        default ""

    config CS_INV_WIFI_PASS
        string "WiFi password"
        default ""

    config CS_INV_MQTT_HOST
        string "MQTT broker host"
        default "mqtt.jiuxiaoyw.online"

    config CS_INV_MQTT_PORT
        int "MQTT broker port"
        default 8883

    config CS_INV_MQTT_USERNAME
        string "MQTT username"
        default "CSKJ-INV-DEVICE-6K2"

    config CS_INV_MQTT_PASSWORD
        string "MQTT password"
        default "CSKJINVDEVICE6K2"

    config CS_INV_CACHE_MAX_ITEMS
        int "Offline cache max items"
        default 500

    config CS_INV_CACHE_TTL_DAYS
        int "Offline cache TTL days"
        default 7

endmenu
```

## tools/rf_diagnostic/sdkconfig.defaults
```kconfig
# ESP32-C2 RF Diagnostic - sdkconfig defaults
CONFIG_IDF_TARGET="esp32c2"

# Flash
CONFIG_ESPTOOLPY_FLASHSIZE_4MB=y

# WiFi
CONFIG_ESP_WIFI_STATIC_RX_BUFFER_NUM=6
CONFIG_ESP_WIFI_DYNAMIC_RX_BUFFER_NUM=12
CONFIG_ESP_WIFI_DYNAMIC_TX_BUFFER_NUM=16

# BLE
CONFIG_BT_ENABLED=y
CONFIG_BT_BLUEDROID_ENABLED=y
CONFIG_BT_BLE_ENABLED=y
CONFIG_BT_BLE_42_FEATURES_SUPPORTED=y
CONFIG_BTDM_CTRL_MODE_BLE_ONLY=y

# Log level
CONFIG_LOG_DEFAULT_LEVEL_INFO=y

# FreeRTOS
CONFIG_FREERTOS_HZ=1000
```
