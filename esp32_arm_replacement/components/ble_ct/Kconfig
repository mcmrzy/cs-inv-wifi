## esp32_arm_replacement/components/ble_ct/Kconfig
```kconfig
menuconfig BLE_CT_ENABLED
    bool "Enable BLE Control & Telemetry (CSIV-CT)"
    default y
    help
        Enable BLE local mode for device control and telemetry.

config BLE_CT_AUTH_LOCKOUT_SECONDS
    int "Auth failure lockout duration (seconds)"
    default 60

config BLE_CT_BIND_WINDOW_SECONDS
    int "Binding window duration (seconds)"
    default 600
```

## esp32_direct/main/Kconfig.projbuild
```kconfig
menu "CS_INV ESP32 Direct Controller"
    config DIRECT_BINDING_PUBLIC_KEY
        string "Cloud binding Ed25519 public key (64 lowercase hex, empty disables)"
        default ""
        help
            Pin the production server public key. Empty preserves UNKNOWN;
            never embed a signing private key in firmware.
    config DIRECT_IDENTITY_PRODUCTION
        bool "Use per-device factory identity (no fixed SN)"
        default n
    config DIRECT_FACTORY_WRITES
        bool "Enable physical USB factory provisioning/test commands"
        default n
        help
            Enable only for factory/commissioning images. Identity lock persists
            across firmware changes. Shipping builds provide inspection only.


    config DIRECT_BOOT_DIAGNOSTICS
        bool "Periodic USB boot diagnostics"
        default n
        help
            Report startup stage every 2 seconds. Buzzer is disabled at
            application entry; startup does not wait for USB reconnection.

    config DIRECT_BUZZ_PIN
        int "Buzzer GPIO (-1 disables buzzer output)"
        default 8

    config DIRECT_BUZZ_ACTIVE_LEVEL
        int "Buzzer active level (0 or 1)"
        range 0 1
        default 1

    config DIRECT_DSP_TX_PIN
        int "DSP UART TX GPIO (-1 disables direct bus)"
        default -1

    config DIRECT_DSP_RX_PIN
        int "DSP UART RX GPIO (-1 disables direct bus)"
        default -1

    config DIRECT_BMS_TX_PIN
        int "BMS UART TX GPIO (-1 disables direct bus)"
        default -1

    config DIRECT_BMS_RX_PIN
        int "BMS UART RX GPIO (-1 disables direct bus)"
        default -1

    config DIRECT_BMS_RS485_DE_PIN
        int "BMS RS485 DE/RE GPIO (-1 if transceiver switches direction automatically)"
        default -1

    config DIRECT_CAN_IDLE_TX_PIN
        int "Unused CAN transceiver TX GPIO held recessive (-1 disables)"
        range -1 21
        default -1
        help
            Hold the unused CAN transceiver D input high at application entry.
            This pin must not also connect to LCD CS or another peripheral.

    choice DIRECT_BMS_PROTOCOL
        prompt "Direct BMS application protocol"
        default DIRECT_BMS_7C
        config DIRECT_BMS_MODBUS
            bool "Modbus 0x03, 37 registers"
        config DIRECT_BMS_7C
            bool "Private 0x7C telemetry"
    endchoice

    config DIRECT_LCD_ISOLATION_TEST
        bool "LCD-only isolation loop (no wireless or business startup)"
        depends on DIRECT_LCD_4WIRE && !DIRECT_LCD_GPIO_SPI
        default n
        help
            Dedicated diagnostic image: red, green, blue, black, white and
            checkerboard forever. Build with a 20 MHz hardware SPI clock.

    config DIRECT_LCD_COLOR_TEST
        bool "Run LCD RGB startup test"
        default n
        help
            Diagnostic color sequence. Disable for normal touch/menu operation.

    config DIRECT_LCD_SCLK_PIN
        int "ST7789 SCLK GPIO (-1 disables panel)"
        default -1
    config DIRECT_LCD_MOSI_PIN
        int "ST7789 MOSI GPIO"
        default -1
    choice DIRECT_LCD_INTERFACE
        prompt "ST7789 serial interface"
        default DIRECT_LCD_4WIRE
        config DIRECT_LCD_3WIRE
            bool "3-line, 9-bit SPI (external D/C fixed high)"
        config DIRECT_LCD_4WIRE
            bool "4-line, 8-bit SPI (GPIO drives D/C)"
    endchoice
    config DIRECT_LCD_GPIO_SPI
        bool "LCD diagnostic using GPIO software SPI"
        depends on DIRECT_LCD_4WIRE && DIRECT_BOOT_DIAGNOSTICS
        default n
        help
            Bypass the SPI peripheral. Drive mode-0, MSB-first bytes with
            2 microseconds per half-cycle and yield between pixel batches.
    config DIRECT_LCD_SPI_CLOCK_HZ
        int "LCD hardware SPI clock in Hz"
        range 100000 40000000
        default 8000000
        help
            Applies to hardware SPI only. Validate wiring before increasing.
    config DIRECT_LCD_MINIMAL_INIT
        bool "ST7789 minimal initialization using factory power/gamma defaults"
        depends on DIRECT_LCD_4WIRE
        default n
        help
            Reset and use the controller's factory power/gamma values.
            Configure only sleep exit, orientation, RGB565, RAM byte order
            and display mode. This is a comparison profile for the new module.
    config DIRECT_LCD_READBACK_TERMINAL
        bool "Single LCD register readback diagnostic"
        depends on DIRECT_LCD_GPIO_SPI
        default n
        help
            Write a MADCTL challenge and read it through the shared SDA pin.
            With fixed CS, stop panel transfers afterwards and leave SDA
            high impedance. With GPIO CS, deselect before restoring output
            and continue the display test.
            A failed read does not prove a fault if the module has no readback.
    config DIRECT_LCD_NOCS_BOOT
        bool "Experimental CS-grounded write-only boot profile"
        depends on DIRECT_LCD_CS_PIN = -1 || DIRECT_LCD_CS_FIXED_LOW
        depends on !DIRECT_LCD_READBACK_TERMINAL
        default n
        help
            Hold RESET low at application entry, park SCL high, disable
            GPIO probes and all register reads, then send mode-3 bytes.
            Requires a dedicated display bus. Physical startup validation
            is required; the application cannot control ROM pin states.
    config DIRECT_LCD_CS_PIN
        int "ST7789 CS GPIO (-1 when CS is tied active)"
        default -1
    config DIRECT_LCD_CS_FIXED_LOW
        bool "Hold LCD CS GPIO permanently low"
        depends on DIRECT_LCD_4WIRE && DIRECT_LCD_CS_PIN >= 0
        depends on !DIRECT_LCD_READBACK_TERMINAL
        default n
        help
            Drive CS low before reset release; never deselect it during
            writes. Dedicated display bus and write-only communication.
    config DIRECT_LCD_DC_PIN
        int "ST7789 D/C GPIO (required only in 4-line mode)"
        default -1
    config DIRECT_LCD_RST_PIN
        int "ST7789 reset GPIO (-1 when reset is external)"
        default -1
    config DIRECT_LCD_BL_PIN
        int "ST7789 backlight GPIO (-1 when always powered externally)"
        default -1
    config DIRECT_KEY_ROW_UP_PIN
        int "Matrix key UP row GPIO (-1 disables keys)"
        default -1
    config DIRECT_KEY_ROW_DOWN_PIN
        int "Matrix key DOWN row GPIO"
        default -1
    config DIRECT_KEY_ESC_PIN
        int "Matrix key ESC column GPIO"
        default -1
    config DIRECT_KEY_ENTER_PIN
        int "Matrix key ENTER column GPIO"
        default -1
    config DIRECT_KEY_CLOCK_PIN
        int "BS818A_2 key clock GPIO (-1 disables keys)"
        default -1
    config DIRECT_KEY_DATA_PIN
        int "BS818A_2 key data GPIO"
        default -1
    choice DIRECT_KEY_PROTOCOL
        prompt "Panel key hardware"
        default DIRECT_KEY_BS818A
        config DIRECT_KEY_BS818A
            bool "BS818A_2 serial touch keys (App(10) active branch)"
        config DIRECT_KEY_MATRIX
            bool "Legacy four-wire key matrix"
    endchoice

    config CS_INV_UART_TX_PIN
        int "UART TX GPIO (U0TXD)"
        default 1

    config CS_INV_UART_RX_PIN
        int "UART RX GPIO (U0RXD)"
        default 0

    config CS_INV_UART_BAUD
        int "UART baudrate"
        default 115200

    config CS_INV_WIFI_SSID
        string "WiFi SSID (NVS 无配置时使用, 留空则等待)"
        default ""

    config CS_INV_WIFI_PASS
        string "WiFi password"
        default ""

    config CS_INV_MQTT_HOST
        string "MQTT broker host"
        default "mqtt.jiuxiaoyw.online"

    config CS_INV_MQTT_PORT
        int "MQTT broker port"
        default 8883

    config CS_INV_MQTT_USERNAME
        string "MQTT username"
        default "CSKJ-INV-DEVICE-6K2"

    config CS_INV_MQTT_PASSWORD
        string "MQTT password"
        default "CSKJINVDEVICE6K2"

    config CS_INV_CACHE_MAX_ITEMS
        int "Offline cache max items"
        default 500

    config CS_INV_CACHE_TTL_DAYS
        int "Offline cache TTL days"
        default 7

    config DIRECT_DSP_OTA_PACKET0_PROBE
        bool "Diagnostic ONLY: erase DSP, send one packet, capture 2s, keep Boot"
        default n
        help
            Destructive diagnostic image. A DSP OTA request sends only packet 0
            once, captures its raw reply, and never reports upgrade success or
            sends EOT. DSP polling stays paused until a new job or explicit exit.
            Keep disabled for normal full-image upgrades.

endmenu
```

## esp32_modbus_panel/main/Kconfig.projbuild
```kconfig
rsource "../../esp32_direct/main/Kconfig.projbuild"
menu "Modbus inverter panel"
    config PANEL_LED_GPIO
        int "WS2812 status LED data GPIO (-1 disables the chain)"
        range -1 21
        default -1
    config PANEL_LED_BRIGHTNESS
        int "WS2812 status LED brightness (0=off, 255=maximum)"
        range 0 255
        default 24
    config PANEL_BUZZ_FREQUENCY_HZ
        int "Passive buzzer tone frequency (Hz)"
        range 1000 8000
        default 4000
        help
            Match the fitted passive buzzer's rated tone frequency.
            Uses LEDC timer1/channel1; key and alarm pulses last 70ms.
    config PANEL_SLAVE_ADDRESS
        int "Initial Modbus slave address"
        range 1 247
        default 1
    config PANEL_BAUD
        int "Initial UART baud (8N1; parity editable on screen)"
        range 1200 115200
        default 9600
    config PANEL_FACTORY_PROFILE
        int "Factory inverter profile (0=commission on site)"
        range 0 7
        default 0
        help
            Set only for a verified sales SKU. A nonzero selection locks the
            profile, while slave address, baud and parity remain editable.
            1=6KU, 4=12KU, 5=2KU, 7=3KU. Other IDs are retired.
    config PANEL_LCD_BL_ACTIVE_LEVEL
        int "LCD backlight active level"
        range 0 1
        default 1
    config PANEL_LCD_SPI_HZ
        int "LCD SPI frequency"
        range 100000 40000000
        default 40000000
    config PANEL_FORECAST_URL
        string "Direct HTTPS weather forecast endpoint"
        default "https://api.open-meteo.com/v1/forecast"
        help
            Open-Meteo-compatible forecast endpoint, with no query string.
            The public default is for evaluation. Use a licensed or
            self-hosted endpoint for commercial operation.
    config PANEL_CITY_SEARCH_URL
        string "Direct HTTPS city search endpoint"
        default "https://geocoding-api.open-meteo.com/v1/search"
    config PANEL_LCD_SPI_MODE
        int "LCD SPI mode (CS grounded: reset-first mode 3)"
        range 0 3
        default 3
endmenu
```

## esp32_modbus_panel/sdkconfig.defaults
```kconfig
CONFIG_IDF_TARGET="esp32c3"
CONFIG_ESPTOOLPY_FLASHSIZE_4MB=y
CONFIG_PARTITION_TABLE_SINGLE_APP=y
CONFIG_ESP_CONSOLE_USB_SERIAL_JTAG=y
# CONFIG_ESP_CONSOLE_UART_DEFAULT is not set
CONFIG_BOOTLOADER_LOG_LEVEL_WARN=y
CONFIG_LOG_DEFAULT_LEVEL_INFO=y
CONFIG_ESP_MAIN_TASK_STACK_SIZE=8192
CONFIG_FREERTOS_HZ=1000
CONFIG_COMPILER_OPTIMIZATION_SIZE=y
CONFIG_PANEL_SLAVE_ADDRESS=1
CONFIG_PANEL_BAUD=9600
CONFIG_PANEL_LCD_BL_ACTIVE_LEVEL=1
CONFIG_PANEL_LCD_SPI_HZ=8000000
CONFIG_PANEL_LCD_SPI_MODE=3
```

## esp32c2_idf/main/Kconfig.projbuild
```kconfig
menu "CS_INV WiFi Module"

    config CS_INV_UART_TX_PIN
        int "UART TX GPIO"
        default 0

    config CS_INV_UART_RX_PIN
        int "UART RX GPIO"
        default 1

    config CS_INV_LED1_PIN
        int "LED1 GPIO"
        default 18

    config CS_INV_LED2_PIN
        int "LED2 GPIO"
        default 13

    config CS_INV_BTN_PIN
        int "Button GPIO"
        default 9

    config CS_INV_UART_BAUD
        int "UART baudrate"
        default 115200

    config CS_INV_MQTT_HOST
        string "MQTT broker host"
        default "jiuxiaoyw.online"

    config CS_INV_MQTT_PORT
        int "MQTT broker port"
        default 8883

    config CS_INV_MQTT_USERNAME
        string "MQTT username"
        default "CSKJ-INV-DEVICE-6K2"

    config CS_INV_MQTT_PASSWORD
        string "MQTT password"
        default "CSKJINVDEVICE6K2"

    config CS_INV_CACHE_MAX_ITEMS
        int "Offline cache max items"
        default 500

    config CS_INV_CACHE_TTL_DAYS
        int "Offline cache TTL days"
        default 7

endmenu
```

## esp32c2_idf/sdkconfig.defaults
```kconfig
CONFIG_IDF_TARGET="esp32c2"
CONFIG_ESPTOOLPY_FLASHSIZE_4MB=y
# mbedTLS 裁剪
CONFIG_MBEDTLS_CERTIFICATE_BUNDLE=y
# CONFIG_MBEDTLS_CERTIFICATE_BUNDLE_DEFAULT_FULL is not set
CONFIG_MBEDTLS_CERTIFICATE_BUNDLE_DEFAULT_CRC=y
CONFIG_MBEDTLS_SSL_IN_CONTENT_LEN=4096
CONFIG_MBEDTLS_SSL_OUT_CONTENT_LEN=2048
# CONFIG_MBEDTLS_SSL_KEEP_PEER_CERTIFICATE is not set
# CONFIG_MBEDTLS_PKCS7_C is not set

# 禁用 ESP-NOW
CONFIG_ESP_WIFI_ESPNOW_ENABLE=n
CONFIG_PARTITION_TABLE_CUSTOM=y
CONFIG_PARTITION_TABLE_CUSTOM_FILENAME="partitions.csv"
CONFIG_BOOTLOADER_APP_ROLLBACK_ENABLE=y

CONFIG_CS_INV_UART_TX_PIN=0
CONFIG_CS_INV_UART_RX_PIN=1

# WiFi 内存优化 (为 BLE 腾出 RAM)
CONFIG_ESP_WIFI_STATIC_RX_BUFFER_NUM=3
CONFIG_ESP_WIFI_DYNAMIC_RX_BUFFER_NUM=6
CONFIG_ESP_WIFI_DYNAMIC_TX_BUFFER_NUM=4
CONFIG_ESP_WIFI_RX_BA_WIN=3
CONFIG_ESP_WIFI_SOFTAP_SUPPORT=y

# BLE NimBLE 内存优化 (仅做 PERIPHERAL 配网)
CONFIG_BT_ENABLED=y
CONFIG_BT_NIMBLE_ENABLED=y
CONFIG_BT_NIMBLE_ROLE_PERIPHERAL=y
# CONFIG_BT_NIMBLE_ROLE_CENTRAL is not set
CONFIG_BT_NIMBLE_ROLE_BROADCASTER=y
# CONFIG_BT_NIMBLE_ROLE_OBSERVER is not set
CONFIG_BT_NIMBLE_MAX_CONNECTIONS=1
CONFIG_BT_NIMBLE_MAX_BONDS=1
CONFIG_BT_NIMBLE_MAX_CCCDS=4
CONFIG_BT_NIMBLE_MSYS_1_BLOCK_COUNT=4
CONFIG_BT_NIMBLE_MSYS_2_BLOCK_COUNT=2
CONFIG_BT_NIMBLE_HOST_TASK_STACK_SIZE=3072
CONFIG_BT_NIMBLE_ATT_PREFERRED_MTU=256
CONFIG_BT_NIMBLE_ATT_MAX_PREP_ENTRIES=4
CONFIG_BT_NIMBLE_GATT_MAX_PROCS=1
CONFIG_BT_NIMBLE_TRANSPORT_ACL_FROM_LL_COUNT=4
CONFIG_BT_NIMBLE_TRANSPORT_EVT_COUNT=4
CONFIG_BT_NIMBLE_TRANSPORT_EVT_DISCARD_COUNT=2
CONFIG_BT_NIMBLE_LOW_SPEED_MODE=y
# CONFIG_BT_NIMBLE_PROX_SERVICE is not set
# CONFIG_BT_NIMBLE_ANS_SERVICE is not set
# CONFIG_BT_NIMBLE_CTS_SERVICE is not set
# CONFIG_BT_NIMBLE_HTP_SERVICE is not set
# CONFIG_BT_NIMBLE_IPSS_SERVICE is not set
# CONFIG_BT_NIMBLE_TPS_SERVICE is not set
# CONFIG_BT_NIMBLE_IAS_SERVICE is not set
# CONFIG_BT_NIMBLE_LLS_SERVICE is not set
# CONFIG_BT_NIMBLE_SPS_SERVICE is not set
# CONFIG_BT_NIMBLE_HR_SERVICE is not set
# CONFIG_BT_NIMBLE_BAS_SERVICE is not set
# CONFIG_BT_NIMBLE_DIS_SERVICE is not set
# CONFIG_BT_NIMBLE_DTM_MODE_TEST is not set
# CONFIG_BT_NIMBLE_SM_SIGN_CNT is not set
# CONFIG_BT_NIMBLE_CPFD_CAFD is not set
# CONFIG_BT_NIMBLE_RECONFIG_MTU is not set
# CONFIG_BT_NIMBLE_EXTRA_ADV_FIELDS is not set

CONFIG_ESP_PHY_CALIBRATION_AND_DATA_STORAGE=n
CONFIG_ESP_PHY_INIT_DATA_IN_PARTITION=n

CONFIG_ESPTOOLPY_FLASHFREQ_30M=y
CONFIG_XTAL_FREQ_40=y

CONFIG_MQTT_PROTOCOL_311=y
CONFIG_MQTT_BUFFER_SIZE=1024
CONFIG_MQTT_TASK_STACK_SIZE=4096

# HTTPS 仍需要（MQTT TLS），但裁剪 HTTP Server
CONFIG_ESP_HTTP_CLIENT_ENABLE_HTTPS=y

CONFIG_FREERTOS_HZ=1000
CONFIG_ESP_TASK_WDT_TIMEOUT_S=30
CONFIG_ESP_MAIN_TASK_STACK_SIZE=4096
CONFIG_ESP_SYSTEM_EVENT_TASK_STACK_SIZE=3072

CONFIG_COMPILER_OPTIMIZATION_SIZE=y
CONFIG_ESP_DEFAULT_CPU_FREQ_MHZ_120=y

CONFIG_CS_INV_LED1_PIN=18
CONFIG_CS_INV_UART_TX_PIN=0
CONFIG_CS_INV_UART_RX_PIN=1
```

## esp32c2_test/sdkconfig.defaults
```kconfig
CONFIG_IDF_TARGET="esp32c2"
CONFIG_ESPTOOLPY_FLASHSIZE_4MB=y
CONFIG_ESPTOOLPY_FLASHFREQ_40M=y
```
