/* Generated from tools/native_locale_terms.txt; longest source match wins. */
static const char zh_text[]=
"通信配置已变更，请重新打开参数\0"
"未取得操作回执，请核对当前配置\0"
"当前实际值已显示，请核对后重试\0"
"未收到有效完成应答，请稍后重试\0"
"仅可在待机、市电或电池模式修改\0"
"方向键调整  确认复核  返回取消\0"
"其他操作正在进行，请稍后再试\0"
"其他操作进行中，可浏览或返回\0"
"电池电流: 正为放电，负为充电\0"
"上下选择  确认修改  返回分类\0"
"左右调整  确认复核  返回取消\0"
"上下选择  左右翻页  确认进入\0"
"上下翻页  返回  历史仅供参考\0"
"逆变器将退出远程开关机模式\0"
"机型已保存，请重新选择参数\0"
"先在维护诊断确认逆变器机型\0"
"此页仅读取，不发送升级命令\0"
"历史数据，不能作为当前告警\0"
"电池参数已变化，请重新进入\0"
"确认保存本机配置  返回编辑\0"
"确认菜单  右键参数  *为旧值\0"
"确认机型设置  返回参数列表\0"
"确认或返回关闭  方向键继续\0"
"协议已确认，实际值未核对\0"
"结果未知，请检查实际状态\0"
"通信中断，本次修改已取消\0"
"搜索中，运行数据暂停更新\0"
"当前值已失效，请重新编辑\0"
"并机设置仅可在待机时修改\0"
"均衡充电仅适用于铅酸电池\0"
"当前值已变化，请重新编辑\0"
"候选型号不等于已确认机型\0"
"请核对逆变器铭牌后再选择\0"
"识别地址定义存在版本差异\0"
"请核对逆变器本机实际设置\0"
"未自动重发，请核对后再试\0"
"逆变器机型与选定配置不符\0"
"显示上次读取值，正在刷新\0"
"通信已断开，显示上次数据\0"
"仅可在待机或市电模式修改\0"
"上下翻页  确认目录  返回\0"
"配置保存失败，查看诊断\0"
"连接已恢复，可继续操作\0"
"按当前波特率和校验搜索\0"
"此电池类型使用固定参数\0"
"此机型电池定义尚未确认\0"
"状态已改变，设置未发送\0"
"请先用方向键选择拟设值\0"
"已到此机型可设置的边界\0"
"条件恢复后可以重新尝试\0"
"左减右加，上加下减快调\0"
"请核对铭牌，再确认机型\0"
"主控升级包格式尚未明确\0"
"请联系安装人员确认机型\0"
"逆变器当前值与目标不同\0"
"确认重试  返回参数列表\0"
"确认发送  返回取消操作\0"
"左右切换诊断  返回退出\0"
"缺少最新运行模式数据\0"
"搜索结束，未找到从机\0"
"请检查连接和运行状态\0"
"搜索期间暂停实时监测\0"
"当前运行状态禁止设置\0"
"缺少最新电池类型数据\0"
"此机型不支持这一设置\0"
"数值未改变，无需发送\0"
"请按铭牌选择实际机型\0"
"修改只影响这一项参数\0"
"按用途选择，确认进入\0"
"正在搜索，返回键停止\0"
"本页无条目，向上翻页\0"
"按用途浏览逆变器参数\0"
"来自电池，确认后应用\0"
"逆变器已返回完成应答\0"
"当前模式使用固定值\0"
"命令失败，查看诊断\0"
"本机通信配置已保存\0"
"搜索结束，找到地址\0"
"开启后负载可能通电\0"
"关闭后负载可能断电\0"
"同时启用远程开关机\0"
"部分告警数据已过期\0"
"当前告警状态待确认\0"
"请求未提交，请重试\0"
"未向逆变器发送设置\0"
"命令处理中，请等待\0"
"部分告警数据未收到\0"
"读回值与目标不一致\0"
"选择分类，确认进入\0"
"返回后可以重新设置\0"
"正在保存并检查结果\0"
"确认搜索  返回取消\0"
"上下翻页  返回退出\0"
"确认进入  返回退出\0"
"返回取消  确认保存\0"
"上下选择  左右调值\0"
"正在发送，请等待\0"
"已应答，等待处理\0"
"实际值已回读确认\0"
"搜索中断，请重试\0"
"逆变器无有效应答\0"
"请先确认实际机型\0"
"只读搜索从机地址\0"
"主控升级只读诊断\0"
"不支持此写入命令\0"
"该地址不支持设置\0"
"逆变器拒绝参数值\0"
"未报告故障或告警\0"
"尚未收到告警数据\0"
"自动检测市电频率\0"
"确认查看参数分类\0"
"机型已由出厂锁定\0"
"已保存并读回确认\0"
"设备未返回当前值\0"
"并机输出参数不同\0"
"电池辅助电源故障\0"
"此机型仅可读取\0"
"等待逆变器数据\0"
"请先选择拟设值\0"
"确认逆变器机型\0"
"逆变器处理失败\0"
"停用远程开关机\0"
"逆变器控制面板\0"
"发电机额定功率\0"
"发电机最大功率\0"
"消除发电机告警\0"
"电池低压告警点\0"
"双输出截止电压\0"
"逆变器自动熄屏\0"
"继电器后软启动\0"
"逆变器蜂鸣静音\0"
"主输入变化警告\0"
"方向键切换选项\0"
"调整后确认保存\0"
"设备不支持读取\0"
"并机无电池运行\0"
"逆变器电池协议\0"
"并机配置不兼容\0"
"母线IP软启故障\0"
"返回参数列表\0"
"正在停止搜索\0"
"等待开始搜索\0"
"通信未初始化\0"
"当前运行设置\0"
"均衡充电使能\0"
"均衡充电时间\0"
"均衡延时时间\0"
"均衡间隔天数\0"
"立即均衡充电\0"
"市电充电电流\0"
"最大充电电流\0"
"输出视在功率\0"
"电池开路警告\0"
"双输出截止SOC\0"
"自动返回首页\0"
"光伏今日电量\0"
"光伏累计电量\0"
"设备读取失败\0"
"历史仅供参考\0"
"设置应答超时\0"
"自动 / 待确认\0"
"市电软启失败\0"
"电池软启故障\0"
"逆变软启故障\0"
"并机序号异常\0"
"并机通信异常\0"
"并机电池压差\0"
"并机市电压差\0"
"并机设置缺相\0"
"并机同步丢失\0"
"逆变负载异常\0"
"并机压差频差\0"
"电池低于启动\0"
"电表通信失败\0"
"最大放电电流\0"
"电池未接检测\0"
"温度降额策略\0"
"母线软启故障\0"
"硬件过流 DC/DC\0"
"光伏硬件过流\0"
"热敏电阻开路\0"
"逆变硬件过流\0"
"屏幕Flash故障\0"
"古瑞瓦特 GRO\0"
"设备返回值\0"
"设备已受理\0"
"设置已生效\0"
"设置未生效\0"
"命令排队中\0"
"命令未发送\0"
"已停止搜索\0"
"暂不能修改\0"
"开启逆变器\0"
"关闭逆变器\0"
"市电与负载\0"
"电池与充电\0"
"充电与电池\0"
"电量与输出\0"
"输出与模式\0"
"发电机使能\0"
"发电机功能\0"
"发电机电压\0"
"发电机电流\0"
"发电机频率\0"
"发电机功率\0"
"输出优先级\0"
"充电优先级\0"
"电池关机点\0"
"电池转市电\0"
"市电转电池\0"
"双输出时间\0"
"过载转旁路\0"
"低功耗省电\0"
"光伏总功率\0"
"开关机操作\0"
"通信已断开\0"
"机型待确认\0"
"可烧录类型\0"
"请手动选择\0"
"充电与供电\0"
"机型不匹配\0"
"无引导程序\0"
"程序烧录中\0"
"并机频率差\0"
"充电器短路\0"
"发电机波形\0"
"发电机过载\0"
"发电机欠压\0"
"发电机过压\0"
"市电不稳定\0"
"逆变器设置\0"
"向电网送电\0"
"从电网取电\0"
"故障与告警\0"
"市电低压点\0"
"市电高压点\0"
"当前待确认\0"
"发电机掉电\0"
"CT连接异常\0"
"充电2温度\0"
"未知/自动\0"
"功能开关2\0"
"日月元 VOL\0"
"电池型号\0"
"正在读取\0"
"读取状态\0"
"读取超时\0"
"上次数据\0"
"电池状态\0"
"操作结果\0"
"光伏输入\0"
"逆变器BMS\0"
"温度监测\0"
"全部参数\0"
"均衡充电\0"
"均衡电压\0"
"发电通路\0"
"运行模式\0"
"输出电压\0"
"充电功能\0"
"充电优先\0"
"输出频率\0"
"输出电流\0"
"输出功率\0"
"电池类型\0"
"电池电压\0"
"电池电流\0"
"电池电量\0"
"电池功率\0"
"恒压目标\0"
"浮充目标\0"
"并机模式\0"
"并机序号\0"
"并机设置\0"
"双路输出\0"
"低SOC关机\0"
"转电池SOC\0"
"转市电SOC\0"
"过温重启\0"
"过载重启\0"
"系统功能\0"
"市电电压\0"
"市电电流\0"
"市电频率\0"
"市电功率\0"
"负载电压\0"
"负载功率\0"
"负载比例\0"
"母线电压\0"
"逆变温度\0"
"充电温度\0"
"环境温度\0"
"放电温度\0"
"参数分类\0"
"参数设置\0"
"运行参数\0"
"故障告警\0"
"通信配置\0"
"通信诊断\0"
"从机地址\0"
"候选机型\0"
"未知类型\0"
"升级状态\0"
"升级能力\0"
"运行状态\0"
"功能状态\0"
"能流状态\0"
"功能开关\0"
"搜索结束\0"
"找到地址\0"
"搜索地址\0"
"连接异常\0"
"连接正常\0"
"负载供电\0"
"注水铅酸\0"
"磷酸铁锂\0"
"不限时间\0"
"母线过压\0"
"母线欠压\0"
"电池过流\0"
"电池过压\0"
"母线短路\0"
"逆变过压\0"
"逆变欠压\0"
"逆变短路\0"
"负功保护\0"
"过载故障\0"
"光伏反接\0"
"电池未接\0"
"电池欠压\0"
"电池低压\0"
"电池过充\0"
"过温预留\0"
"风扇堵转\0"
"存储故障\0"
"并机版本\0"
"低SOC告警\0"
"电池短路\0"
"出厂机型\0"
"运行数据\0"
"充电功率\0"
"放电功率\0"
"常用设置\0"
"认证错误\0"
"PV能量弱\0"
"派能 PYL\0"
"铁塔 IRF\0"
"沛城 PAC\0"
"未返回\0"
"已断联\0"
"不支持\0"
"发电机\0"
"恒压点\0"
"浮充点\0"
"BMS地址\0"
"BMS通信\0"
"BMS电压\0"
"BMS电流\0"
"BMS电量\0"
"BMS温度\0"
"BMS故障\0"
"BMS告警\0"
"PV1电压\0"
"PV1电流\0"
"PV1功率\0"
"PV2电压\0"
"PV2电流\0"
"PV2功率\0"
"PV1温度\0"
"PV2温度\0"
"开关机\0"
"主菜单\0"
"波特率\0"
"6KU并机\0"
"未连接\0"
"未定义\0"
"未启用\0"
"三元锂\0"
"锂电池\0"
"自定义\0"
"初始化\0"
"应答码\0"
"待确认\0"
"MCU故障\0"
"保留位\0"
"BMS丢失\0"
"当前值\0"
"拟设值\0"
"PV过压\0"
"历史 \0"
"标准\0"
"串口\0"
"铅酸\0"
"胶体\0"
"自动\0"
"循环\0"
"开启\0"
"关闭\0"
"上电\0"
"待机\0"
"市电\0"
"光伏\0"
"电池\0"
"负载\0"
"充电\0"
"电量\0"
"故障\0"
"告警\0"
"关机\0"
"测试\0"
"升级\0"
"在线\0"
"离线\0"
"未知\0"
"当前\0"
"上次\0"
"拟设\0"
"目标\0"
"操作\0"
"输入\0"
"运行\0"
"机型\0"
"软件\0"
"版本\0"
"写入\0"
"异常\0"
"轮询\0"
"错误\0"
"搜索\0"
"找到\0"
"原始\0"
"确认\0"
"过温\0"
"过载\0"
"地址\0"
"节\0"
"，\0"
"项\0"
;
static const char en_text[]=
"Link changed; reopen setting\0"
"Receipt lost; verify current setup\0"
"Check displayed value before retry\0"
"No completion reply. Try again.\0"
"Edit in standby, grid or battery mode\0"
"Arrows change  ENTER review  BACK\0"
"Another operation; retry later\0"
"Busy; browsing and BACK available\0"
"Battery A: + discharge / - charge\0"
"UP/DN select  ENTER edit  BACK\0"
"L/R change  ENTER review  BACK\0"
"Up/down select  L/R page  ENTER\0"
"UP/DN pages  BACK  History only\0"
"Exits remote power control mode\0"
"Model saved; reopen setting\0"
"Confirm model in Service first\0"
"Read only; no update is sent\0"
"Historical data; alarms may differ\0"
"Battery limits changed; reopen\0"
"ENTER save  BACK edit\0"
"ENTER menu  RIGHT data  * stale\0"
"ENTER model setup  BACK list\0"
"ENTER/BACK close  arrows browse\0"
"Accepted; actual value unverified\0"
"Unknown result; check inverter\0"
"Link lost. Edit discarded.\0"
"Searching. Live data paused.\0"
"Value is stale. Edit again.\0"
"Parallel changes need standby\0"
"Equalization: lead-acid only\0"
"Current value changed; reopen\0"
"Candidate is not a confirmed model\0"
"Check the inverter nameplate\0"
"Model register differs by revision\0"
"Verify the inverter's own setting\0"
"No auto retry; verify before retry\0"
"Inverter model mismatch\0"
"Last values; refreshing\0"
"Disconnected; last values\0"
"Edit in standby or grid mode\0"
"Up/down page  ENTER index  BACK\0"
"Save failed; see diagnostics\0"
"Connection restored\0"
"Uses current baud and parity\0"
"Fixed for this battery type\0"
"Battery definition unconfirmed\0"
"State changed; nothing sent\0"
"Use arrow keys to select a value\0"
"Allowed limit reached\0"
"Retry when conditions recover\0"
"L -  R +   UP +10  DN -10\0"
"Check nameplate; confirm model\0"
"Inverter image format unspecified\0"
"Ask installer to confirm model\0"
"Device returned a different value\0"
"ENTER retry  BACK list\0"
"ENTER send  BACK cancel\0"
"L/R diagnostics  BACK exit\0"
"Fresh operating mode unavailable\0"
"No inverter found\0"
"Check link and inverter status\0"
"Live data pauses during search\0"
"Current state blocks changes\0"
"Fresh battery type unavailable\0"
"Setting unsupported on this model\0"
"Value unchanged; nothing sent\0"
"Select the model on the nameplate\0"
"Only this setting will change\0"
"Select a group; press ENTER\0"
"Searching; BACK to stop\0"
"No entries here; scroll up\0"
"Browse settings by function\0"
"From battery; press OK to apply\0"
"Inverter reported completion\0"
"Fixed in current mode\0"
"Request failed; see diagnostics\0"
"Local communication saved\0"
"Search found address \0"
"Loads may energize\0"
"Loads may lose power\0"
"Also enables remote power control\0"
"Some alarm data is stale\0"
"Current alarm status unknown\0"
"Not submitted; retry\0"
"No setting sent to the inverter\0"
"Request in progress; please wait\0"
"Some alarm data is unavailable\0"
"Read value differs from target\0"
"Choose a category\0"
"Close to edit again\0"
"Saving and checking settings\0"
"ENTER search  BACK cancel\0"
"UP/DN pages  BACK exit\0"
"ENTER open  BACK exit\0"
"BACK cancel  ENTER save\0"
"Up/down select  L/R change\0"
"Sending request\0"
"Acknowledged; processing\0"
"Actual value confirmed\0"
"Search interrupted. Try again.\0"
"No inverter response\0"
"Confirm the inverter model first\0"
"Search address (read only)\0"
"Inverter update diagnostics\0"
"Write command unsupported\0"
"Register is not writable\0"
"Inverter rejected this value\0"
"No fault or warning reported\0"
"No alarm data received\0"
"Auto grid frequency\0"
"Enter to view setting groups\0"
"Factory model locked\0"
"Saved and verified\0"
"Not returned\0"
"Parallel output mismatch\0"
"Battery auxiliary supply fault\0"
"Read-only on this model\0"
"Waiting for inverter data\0"
"Select a target value first\0"
"Confirm inverter model\0"
"Inverter processing failed\0"
"Disable remote power control\0"
"Inverter control panel\0"
"Generator rated power\0"
"Generator power limit\0"
"Clear generator warning\0"
"Battery low warning\0"
"Output 2 cutoff voltage\0"
"Inverter screen sleep\0"
"Relay soft start\0"
"Inverter buzzer mute\0"
"Input change warning\0"
"Arrows change option\0"
"Adjust, then press ENTER\0"
"Read unsupported\0"
"Parallel without battery\0"
"Inverter battery protocol\0"
"Parallel config mismatch\0"
"Bus IP start fault\0"
"BACK to settings\0"
"Stopping search\0"
"Waiting to start search\0"
"Communication unavailable\0"
"Current operating settings\0"
"Equalization enable\0"
"Equalization duration\0"
"Equalization timeout\0"
"Equalization interval\0"
"Equalize now\0"
"AC charge current\0"
"Total charge current\0"
"Output apparent power\0"
"Battery open warning\0"
"Output 2 cutoff SOC\0"
"Auto return home\0"
"PV energy today\0"
"PV energy total\0"
"Read failed\0"
"History only\0"
"Setting response timed out\0"
"Auto / unconfirmed\0"
"Grid soft-start failed\0"
"Battery soft-start fault\0"
"Inverter soft-start fault\0"
"Parallel ID fault\0"
"Parallel link fault\0"
"Parallel battery mismatch\0"
"Parallel grid mismatch\0"
"Parallel phase missing\0"
"Parallel sync lost\0"
"Inverter load fault\0"
"Parallel V/f mismatch\0"
"Battery below startup limit\0"
"Meter link failed\0"
"Max discharge current\0"
"Battery presence check\0"
"Thermal derating\0"
"Bus soft-start fault\0"
"DC/DC overcurrent\0"
"PV hardware overcurrent\0"
"NTC open\0"
"Inverter overcurrent\0"
"Panel flash fault\0"
"Growatt GRO\0"
"Device value\0"
"Inverter accepted\0"
"Settings applied\0"
"Settings not applied\0"
"Request queued\0"
"Command was not sent\0"
"Search stopped\0"
"Cannot change now\0"
"Power on inverter\0"
"Power off inverter\0"
"Grid and load\0"
"Battery and charging\0"
"Charging and battery\0"
"Energy and output\0"
"Output and mode\0"
"Generator enable\0"
"Generator enable\0"
"Generator voltage\0"
"Generator current\0"
"Generator frequency\0"
"Generator power\0"
"Output priority\0"
"Charge priority\0"
"Battery cutoff\0"
"Battery to grid\0"
"Grid to battery\0"
"Output 2 duration\0"
"Overload bypass\0"
"Power saving\0"
"PV total power\0"
"Power control\0"
"Link offline\0"
"Model unconfirmed\0"
"Image target\0"
" select manually\0"
"Charging and supply\0"
"Model mismatch\0"
"Bootloader missing\0"
"Firmware writing\0"
"Parallel frequency mismatch\0"
"Charger short circuit\0"
"Generator waveform\0"
"Generator overload\0"
"Generator undervoltage\0"
"Generator overvoltage\0"
"Grid unstable\0"
"Inverter settings\0"
"Grid export\0"
"Grid import\0"
"Faults and warnings\0"
"Grid low limit\0"
"Grid high limit\0"
"Current unknown\0"
"Generator power lost\0"
"CT connection fault\0"
"Charger 2 temperature\0"
"Unknown / auto\0"
"Feature flags 2\0"
"Voltronic VOL\0"
"Battery model\0"
"Reading\0"
"Read status\0"
"Read timeout\0"
"Last data\0"
"Battery status\0"
"Operation result\0"
"PV inputs\0"
"Inverter BMS\0"
"Temperatures\0"
"All settings\0"
"Equalization\0"
"Equalization voltage\0"
"Generator path\0"
"Operating mode\0"
"Output voltage\0"
"Charging\0"
"Charge first\0"
"Output frequency\0"
"Output current\0"
"Output power\0"
"Battery type\0"
"Battery voltage\0"
"Battery current\0"
"Battery SOC\0"
"Battery power\0"
"Bulk target\0"
"Float target\0"
"Parallel mode\0"
"Parallel ID\0"
"Parallel settings\0"
"Secondary output\0"
"Low SOC shutdown\0"
"Return to battery SOC\0"
"Return to grid SOC\0"
"Overtemp restart\0"
"Overload restart\0"
"System functions\0"
"Grid voltage\0"
"Grid current\0"
"Grid frequency\0"
"Grid power\0"
"Load voltage\0"
"Load power\0"
"Load ratio\0"
"Bus voltage\0"
"Inverter temperature\0"
"Charger temperature\0"
"Ambient temperature\0"
"Discharge temperature\0"
"Setting groups\0"
"Settings\0"
"Operating data\0"
"Faults and warnings\0"
"Communication setup\0"
"Link diagnostics\0"
"Slave address\0"
"Model candidate\0"
"Unknown type\0"
"Update state\0"
"Update capability\0"
"Run state\0"
"Function state\0"
"Energy flow state\0"
"Feature flags\0"
"Search ended\0"
"Found address \0"
"Searching address \0"
"Connected; abnormal\0"
"Connected; normal\0"
"Supplying load\0"
"Flooded lead-acid\0"
"LiFePO4\0"
"Unlimited\0"
"Bus overvoltage\0"
"Bus undervoltage\0"
"Battery overcurrent\0"
"Battery overvoltage\0"
"Bus short circuit\0"
"Inverter overvoltage\0"
"Inverter undervoltage\0"
"Inverter short circuit\0"
"Reverse power protection\0"
"Overload fault\0"
"PV reverse polarity\0"
"Battery disconnected\0"
"Battery undervoltage\0"
"Battery low voltage\0"
"Battery overcharge\0"
"Reserved temperature bit\0"
"Fan blocked\0"
"Storage fault\0"
"Parallel version mismatch\0"
"Low SOC warning\0"
"Battery short circuit\0"
"Factory model\0"
"Live data\0"
"Charge power\0"
"Discharge power\0"
"Quick settings\0"
"Authentication fault\0"
"PV energy low\0"
"Pylontech PYL\0"
"IRF\0"
"PACE PAC\0"
"No value\0"
"Offline\0"
"Unsupported\0"
"Generator\0"
"Bulk voltage\0"
"Float voltage\0"
"BMS address\0"
"BMS link\0"
"BMS voltage\0"
"BMS current\0"
"BMS SOC\0"
"BMS temperature\0"
"BMS fault\0"
"BMS warning\0"
"PV1 voltage\0"
"PV1 current\0"
"PV1 power\0"
"PV2 voltage\0"
"PV2 current\0"
"PV2 power\0"
"PV1 temperature\0"
"PV2 temperature\0"
"Power control\0"
"Main menu\0"
"Baud rate\0"
"6KU parallel\0"
"Not connected\0"
"Undefined\0"
"Inactive\0"
"NMC\0"
"Lithium\0"
"User-defined\0"
"Initializing\0"
"Response code\0"
"unconfirmed\0"
"MCU fault\0"
"Reserved bit\0"
"BMS link lost\0"
"Current value\0"
"Proposed value\0"
"PV overvoltage\0"
"History \0"
"Standard\0"
"Serial\0"
"Lead-acid\0"
"Gel\0"
"Auto\0"
"Cycle\0"
"On\0"
"Off\0"
"Power-up\0"
"Standby\0"
"Grid\0"
"PV\0"
"Battery\0"
"Load\0"
"Charging\0"
"SOC\0"
"Fault\0"
"Warning\0"
"Shutdown\0"
"Test\0"
"Update\0"
"Online\0"
"Offline\0"
"Unknown\0"
"Current\0"
"Previous\0"
"Target\0"
"Target\0"
"Action\0"
"Input\0"
"Run\0"
"Model\0"
"Software\0"
"Version\0"
"Write \0"
" exception \0"
"Reads \0"
" errors \0"
"Search \0"
" found \0"
"Raw \0"
"Confirm\0"
"Overtemperature\0"
"Overload\0"
"Addr \0"
" cells \0"
"; \0"
" items\0"
;
static const translation_t terms[]={
{0,0},
{46,29},
{92,64},
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{8198,8202},
};
